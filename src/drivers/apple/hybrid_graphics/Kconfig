## src/mainboard/apple/macbookpro10_1/Kconfig
```kconfig
if BOARD_APPLE_MACBOOKPRO10_1

config BOARD_SPECIFIC_OPTIONS
	def_bool y
	select BOARD_ROMSIZE_KB_8192
	select EC_ACPI
	select HAVE_ACPI_RESUME
	select HAVE_ACPI_TABLES
	select INTEL_INT15
	select NORTHBRIDGE_INTEL_SANDYBRIDGE
	select SERIRQ_CONTINUOUS_MODE
	select SOUTHBRIDGE_INTEL_C216
	select SYSTEM_TYPE_LAPTOP
	select USE_NATIVE_RAMINIT
	select MAINBOARD_HAS_LIBGFXINIT
	select GFX_GMA_INTERNAL_IS_EDP
	select HAVE_CMOS_DEFAULT
	select HAVE_OPTION_TABLE
	select DRIVERS_APPLE_HYBRID_GRAPHICS

config MAINBOARD_DIR
	string
	default apple/macbookpro10_1

config MAINBOARD_PART_NUMBER
	string
	default "MacBookPro10,1"

config VGA_BIOS_FILE
	string
	default "pci8086,0166.rom"

config VGA_BIOS_ID
	string
	default "8086,0166"

config DRAM_RESET_GATE_GPIO
	int
	default 28

config USBDEBUG_HCD_INDEX
	int
	default 0

config MAX_CPUS
	int
	default 8
endif
```

## src/mainboard/samsung/300e5c/Kconfig
```kconfig
if BOARD_SAMSUNG_300E5C

config BOARD_SPECIFIC_OPTIONS
	def_bool y
	select BOARD_ROMSIZE_KB_8192
	select EC_ACPI
	select HAVE_ACPI_RESUME
	select HAVE_ACPI_TABLES
	select INTEL_INT15
	select MAINBOARD_HAS_LIBGFXINIT
	select GFX_GMA_INTERNAL_IS_LVDS
	select NORTHBRIDGE_INTEL_SANDYBRIDGE
	select SERIRQ_CONTINUOUS_MODE
	select SOUTHBRIDGE_INTEL_C216
	select SYSTEM_TYPE_LAPTOP
	select USE_NATIVE_RAMINIT

config MAINBOARD_DIR
	string
	default "samsung/300e5c"

config MAINBOARD_PART_NUMBER
	string
	default "300E4C/300E5C/300E7C"

config VGA_BIOS_FILE
	string
	default "pci8086,0116.rom"

config VGA_BIOS_ID
	string
	default "8086,0116"

config DRAM_RESET_GATE_GPIO # FIXME: check this
	int
	default 60

config MAX_CPUS
	int
	default 8

config USBDEBUG_HCD_INDEX # FIXME: check this
	int
	default 2
endif
```
